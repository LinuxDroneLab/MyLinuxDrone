/*
* Copyright (C) 2016 Seeed Studio.
*
* This program is free software; you can redistribute it and/or modify
* it under the terms of the GNU General Public License version 2 as
* published by the Free Software Foundation.
*/
/dts-v1/;
/plugin/;
/{
compatible = "ti,beaglebone", "ti,beaglebone-black", "ti,beaglebone-green";
part-number = "BB-PWM2";
version = "00A0";
 
/*
fragment@0 {
target = <&am33xx_pinmux>;
       __overlay__ {
              pinctrl_spec: pinmux_gpio_pins {
                 pinctrl-single,pins = < 0x20 0x04 0x24 0x04 >;
              };
       };
};
fragment@1 {
target = <&ocp>;
       __overlay__ {
              test_helper: helper {
                   compatible = "gpio-of-helper";
                   pinctrl-names = "default";
                   pinctrl-0 = <&pinctrl_spec>;
                   status = "okay";
              };
       };
};
*/

fragment@2 {
target = <&epwmss2>;
       __overlay__ {
              status = "okay";
              };
       };
fragment@3 {
target = <&ehrpwm2>;
       __overlay__ {
              status = "okay";
              };
      };
};

